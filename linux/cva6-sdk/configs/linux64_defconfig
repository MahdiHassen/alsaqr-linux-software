## linux/cva6-sdk/configs/linux64_defconfig
```kconfig
CONFIG_DEFAULT_HOSTNAME="ariane-fpga"
# CONFIG_CROSS_MEMORY_ATTACH is not set
CONFIG_NAMESPACES=y
CONFIG_BLK_DEV_INITRD=y
CONFIG_INITRAMFS_SOURCE="${BR_BINARIES_DIR}/rootfs.cpio"
CONFIG_EMBEDDED=y
# perf support (RISC-V PMU)
CONFIG_PROFILING=y
CONFIG_PERF_EVENTS=y
CONFIG_HW_PERF_EVENTS=y
CONFIG_RISCV_PMU=y
CONFIG_RISCV_PMU_LEGACY=y
CONFIG_RISCV_PMU_SBI=y
CONFIG_DEBUG_FS=y
CONFIG_SMP=y
CONFIG_HZ_100=y
CONFIG_CMDLINE="earlyprintk"
CONFIG_MODULES=y
CONFIG_MODULE_UNLOAD=y
# CONFIG_BLK_DEV_BSG is not set
CONFIG_PARTITION_ADVANCED=y
# CONFIG_COMPACTION is not set
CONFIG_UNIX=y
# CONFIG_TLS is not set
# CONFIG_IP_MULTICAST is not set
# CONFIG_WIRELESS is not set
# CONFIG_DEVTMPFS is not set
# CONFIG_DEVTMPFS_MOUNT is not set
CONFIG_VIRTIO_BLK=y
# CONFIG_EEPROM_AT24 is not set
# CONFIG_VXLAN is not set
# CONFIG_LOWRISC_DIGILENT_100MHZ is not set
# CONFIG_XILINX_EMACLITE is not set
# CONFIG_MDIO_BCM_UNIMAC is not set
# CONFIG_MDIO_BITBANG is not set
# CONFIG_MDIO_BUS_MUX_GPIO is not set
# CONFIG_MDIO_BUS_MUX_MMIOREG is not set
# CONFIG_MDIO_BUS_MUX_MULTIPLEXER is not set
# CONFIG_MDIO_GPIO is not set
# CONFIG_REALTEK_PHY is not set
# CONFIG_WLAN is not set
# CONFIG_INPUT_KEYBOARD is not set
# CONFIG_INPUT_MOUSE is not set
# CONFIG_VT is not set
CONFIG_SERIAL_8250=y
CONFIG_SERIAL_8250_CONSOLE=y
CONFIG_SERIAL_OF_PLATFORM=y
CONFIG_SERIAL_UARTLITE=y
CONFIG_HVC_RISCV_SBI=y
CONFIG_VIRTIO_CONSOLE=y
# CONFIG_HW_RANDOM is not set
# CONFIG_I2C is not set
# CONFIG_I2C_OCORES is not set
# CONFIG_SPI is not set
# CONFIG_SPI_XILINX is not set
# CONFIG_GPIOLIB is not set
# CONFIG_GPIO_SYSFS is not set
# CONFIG_GPIO_XILINX is not set
# CONFIG_POWER_RESET is not set
# CONFIG_POWER_RESET_GPIO_RESTART is not set
# CONFIG_USB is not set
# CONFIG_USB_XHCI_HCD is not set
# CONFIG_USB_EHCI_HCD is not set
# CONFIG_MMC is not set
# CONFIG_MMC_SPI is not set
# CONFIG_NEW_LEDS is not set
# CONFIG_LEDS_CLASS is not set
# CONFIG_LEDS_PWM is not set
# CONFIG_LEDS_TRIGGERS is not set
# CONFIG_LEDS_TRIGGER_HEARTBEAT is not set
# CONFIG_LEDS_TRIGGER_PANIC is not set
CONFIG_VIRTIO_MMIO=y
# CONFIG_IOMMU_SUPPORT is not set
# CONFIG_PWM is not set
CONFIG_SIFIVE_PLIC=y
# CONFIG_EXT3_FS is not set
CONFIG_PROC_PAGE_MONITOR=y
# CONFIG_TMPFS is not set
# CONFIG_MISC_FILESYSTEMS is not set
# CONFIG_NFS_FS is not set
# CONFIG_NFS_V4 is not set
# CONFIG_NFS_SWAP is not set
# CONFIG_NFS_V4_1 is not set
# CONFIG_NFS_V4_2 is not set
# CONFIG_CRYPTO_ECHAINIV is not set
# CONFIG_CRYPTO_HW is not set
# CONFIG_PRINTK_TIME i not set
CONFIG_STRIP_ASM_SYMS=y
# CONFIG_DEBUG_SECTION_MISMATCH is not set
# CONFIG_STACKTRACE is not set
CONFIG_UIO=y
CONFIG_UIO_PDRV_GENIRQ=y
CONFIG_UIO_DMEM_GENIRQ=y
CONFIG_VIRTIO_MMIO=y
CONFIG_VIRTIO_BLK=y
CONFIG_VIRTIO_CONSOLE=y
CONFIG_VIRTIO_INPUT=y

# Networking: the Xilinx AXI Ethernet of the SoC (hardware/host/xilinx_eth_subsys.sv), DP83867 PHY on the VCU118
CONFIG_NET=y
CONFIG_PACKET=y
CONFIG_INET=y
CONFIG_IP_PNP=y
CONFIG_IP_PNP_DHCP=y
CONFIG_NETDEVICES=y
CONFIG_ETHERNET=y
CONFIG_NET_VENDOR_XILINX=y
CONFIG_XILINX_AXI_EMAC=y
CONFIG_PHYLIB=y
CONFIG_PHYLINK=y
CONFIG_DP83867_PHY=y
CONFIG_NFS_FS=y
CONFIG_NFS_V3=y
CONFIG_ROOT_NFS=y
```
