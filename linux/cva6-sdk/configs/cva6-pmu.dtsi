/* CVA6 HPM event IDs and the six implemented counters (3 through 8). */
/ {
    pmu {
        compatible = "riscv,pmu";
        riscv,event-to-mhpmevent = <0x1 0x0 0x17>, /* cycles */
                                  <0x2 0x0 0x18>, /* retired instructions */
                                  <0x5 0x0 0x09>, /* retired control flow */
                                  <0x6 0x0 0x0a>; /* branch mispredict */
        riscv,event-to-mhpmcounters = <0x1 0x2 0x1f8>, <0x5 0x6 0x1f8>;
        riscv,raw-event-to-mhpmcounters =
            <0x0 0x01 0xffffffff 0xffffffff 0x1f8>,
            <0x0 0x02 0xffffffff 0xffffffff 0x1f8>,
            <0x0 0x03 0xffffffff 0xffffffff 0x1f8>,
            <0x0 0x04 0xffffffff 0xffffffff 0x1f8>,
            <0x0 0x05 0xffffffff 0xffffffff 0x1f8>,
            <0x0 0x06 0xffffffff 0xffffffff 0x1f8>,
            <0x0 0x07 0xffffffff 0xffffffff 0x1f8>,
            <0x0 0x08 0xffffffff 0xffffffff 0x1f8>,
            <0x0 0x09 0xffffffff 0xffffffff 0x1f8>,
            <0x0 0x0a 0xffffffff 0xffffffff 0x1f8>,
            <0x0 0x0b 0xffffffff 0xffffffff 0x1f8>,
            <0x0 0x0c 0xffffffff 0xffffffff 0x1f8>,
            <0x0 0x0d 0xffffffff 0xffffffff 0x1f8>,
            <0x0 0x0e 0xffffffff 0xffffffff 0x1f8>,
            <0x0 0x0f 0xffffffff 0xffffffff 0x1f8>,
            <0x0 0x10 0xffffffff 0xffffffff 0x1f8>,
            <0x0 0x11 0xffffffff 0xffffffff 0x1f8>,
            <0x0 0x12 0xffffffff 0xffffffff 0x1f8>,
            <0x0 0x13 0xffffffff 0xffffffff 0x1f8>,
            <0x0 0x14 0xffffffff 0xffffffff 0x1f8>,
            <0x0 0x15 0xffffffff 0xffffffff 0x1f8>,
            <0x0 0x16 0xffffffff 0xffffffff 0x1f8>,
            <0x0 0x17 0xffffffff 0xffffffff 0x1f8>,
            <0x0 0x18 0xffffffff 0xffffffff 0x1f8>;
    };
};
